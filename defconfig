## defconfig
```kconfig
CONFIG_VENDOR_LENOVO=y
CONFIG_BOARD_LENOVO_T560=y
CONFIG_IFD_BIN_PATH="binaries/ifd.bin"
CONFIG_ME_BIN_PATH="binaries/me_deguarded.bin"
CONFIG_GBE_BIN_PATH="binaries/gbe.bin"
CONFIG_HAVE_IFD_BIN=y
CONFIG_HAVE_ME_BIN=y
CONFIG_HAVE_GBE_BIN=y
CONFIG_LOCALVERSION="t560-uefi"
CONFIG_GENERIC_LINEAR_FRAMEBUFFER=y
CONFIG_PAYLOAD_EDK2=y
CONFIG_SMMSTORE=y
CONFIG_SMMSTORE_SIZE=0x80000
CONFIG_CBFS_SIZE=0x880000
CONFIG_EDK2_BOOT_MANAGER_ESCAPE=y
CONFIG_EDK2_FULL_SCREEN_SETUP=n
CONFIG_EDK2_CBMEM_LOGGING=y
```
